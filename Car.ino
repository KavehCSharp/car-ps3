#include <Drive.h>
#include <U8glib.h>
#include <PS2X_lib.h> 

#define echoPin 2 // Echo Pin (OUTPUT pin in RB URF02)
#define trigPin 3 // Trigger Pin (INPUT pin in RB URF02)

long duration, distance; // Duration used to calculate distance

//Define L298N pin mappings
const int IN1 = 4;
const int IN2 = 5;
const int IN3 = 6;
const int IN4 = 7;

int baseSpeed = 300;

U8GLIB_SH1106_128X64 u8g(U8G_I2C_OPT_NONE);  // I2C / TWI 

PS2X ps2x;

int error = 0; 
bool type = false;
byte vibrate = 0;

int RY=0;
int LX=0;

const unsigned char dashboard[] PROGMEM = {
0xFF, 0xFF, 0xFF, 0xFF, 0xFF, 0xFF, 0xFF, 0xFF, 0xFF, 0xFF, 0xFF, 0xFF, 0xFF, 0xFF, 0xFF, 0xFF,
0x80, 0x00, 0x00, 0x00, 0x00, 0x00, 0x00, 0x00, 0x00, 0x00, 0x00, 0x00, 0x00, 0x00, 0x00, 0x01,
0x80, 0x00, 0x00, 0x00, 0x00, 0x00, 0x00, 0x00, 0x00, 0x00, 0x00, 0x00, 0x00, 0x00, 0x00, 0x01,
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0xFF, 0xFF, 0xFF, 0xFF, 0xFF, 0xFF, 0xFF, 0xFF, 0xFF, 0xFF, 0xFF, 0xFF, 0xFF, 0xFF, 0xFF, 0xFF
};

Drive drive(IN1, IN2, IN3, IN4);  //Create an instance of the function

void setup() {
  //Serial.begin(57600);
  error = ps2x.config_gamepad(12,10,9,11, true, true);

  pinMode(trigPin, OUTPUT);
  pinMode(echoPin, INPUT);
}

int stage=0;

void loop() {

if(stage==0){
  //Splash();
  //delay(3000);
  stage++;
}

if(stage==1){
  Text("Kaveh Taheri");
  delay(1000);

  if(error!=1)
  {
     Text("System OK");
     delay(5000);
     
     Text("Play...");
     delay(1000);
     
     stage++;  
  }
  
  else if(error == 1)
  {
    Text("No controller found"); 
    delay(1000); 
    error = ps2x.config_gamepad(12,10,9,11, true, true);
  }
 
}

if(stage==2)
{ 
    digitalWrite(trigPin, LOW);
    delayMicroseconds(2);
    digitalWrite(trigPin, HIGH);
    delayMicroseconds(10);
    digitalWrite(trigPin, LOW);
    duration = pulseIn(echoPin, HIGH);
    distance = duration/58.2; //Calculate the distance (in cm) based on the speed of sound.
    
    ps2x.read_gamepad(false, false);

    if(ps2x.ButtonPressed(PSB_SELECT))
      type = !type;
     
    RY=ps2x.Analog(PSS_RY);
    LX=ps2x.Analog(PSS_LX);

    if(ps2x.ButtonPressed(PSB_R1))
      Text(String(String(distance)+" cm"));

    if(ps2x.ButtonPressed(PSB_R2) && baseSpeed < 2000)
      baseSpeed+=100;

    if(ps2x.ButtonPressed(PSB_L2) && baseSpeed > 100)
      baseSpeed-=100;

    if(ps2x.ButtonPressed(PSB_L1))
      Text(String("Speed: "+String(baseSpeed)));

    if(type){
      
      Dashboard(String(distance), String(readVcc()), String(127-RY));
      
      if(distance<=10)
      {
        StopSign();
      }
    }

    if(RY < 120 && distance > 10) // 127
    {
      drive.moveForward(baseSpeed);
    } else if(RY>134) // 127
    {
      drive.moveBackward(baseSpeed);
    } else
    {
      drive.moveForward(0);
    }
 
    if(LX<120) // 127
    {
      drive.turnLeft(baseSpeed);
    } else if(LX>134) // 127
    {
      drive.turnRight(baseSpeed);
    }

    if(((LX>120&&LX<134) && (RY>120&&RY<134)))
    {
      drive.moveForward(0);
    }

    

   delay(50); // 1 milisecond!
}

}

float readVcc() {
  long result;
  // Read 1.1V reference against AVcc
  ADMUX = _BV(REFS0) | _BV(MUX3) | _BV(MUX2) | _BV(MUX1);
  delay(2); // Wait for Vref to settle
  ADCSRA |= _BV(ADSC); // Convert
  while (bit_is_set(ADCSRA, ADSC));
  result = ADCL;
  result |= ADCH << 8;
  result = 1126400L / result; // Back-calculate AVcc in mV
  return result/1000;
}

void Text(String s) {

  u8g.firstPage();  
  do {

      u8g.setFont(u8g_font_unifont);
      u8g.drawStr(0, 20, s.c_str());
  
  } while( u8g.nextPage() );

}

void Dashboard(String distance, String vcc, String s)
{
   u8g.firstPage();  
  do {
  
    u8g.setFont(u8g_font_unifont);
    //u8g.drawStr(0, 20, String(distance+" cm").c_str());
    //u8g.drawStr(0, 40, String(vcc+" Volt").c_str());

     u8g.drawBitmapP(0,0,16,64,dashboard);
     // do some speed, voltage, distance
     u8g.drawStr(90, 20, String(distance+"cm").c_str()); // Distance
     
     u8g.drawStr(80, 49, String(vcc+" V").c_str());

     //u8g.setFont(u8g_font_helvB24);
     u8g.drawStr(15, 45, s.c_str()); // Speed
    
  } while( u8g.nextPage() );
}



void StopSign()
{
   u8g.firstPage();  
  do {

     //u8g.setFont(u8g_font_helvB24);
     u8g.drawStr(22, 45, "STOP"); // Speed
   
  } while( u8g.nextPage() );
}
